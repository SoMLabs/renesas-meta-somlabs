## conf/layer.conf
```bitbake
# We have a conf and classes directory, add to BBPATH
BBPATH .= ":${LAYERDIR}"

# We have recipes-* directories, add to BBFILES
BBFILES += "${LAYERDIR}/recipes-*/*/*.bb \
            ${LAYERDIR}/recipes-*/*/*.bbappend"

BBFILE_COLLECTIONS += "meta-somlabs"
BBFILE_PATTERN_meta-somlabs = "^${LAYERDIR}/"
BBFILE_PRIORITY_meta-somlabs = "20"

LAYERDEPENDS_meta-somlabs = "rzg2l rzv2l"
LAYERSERIES_COMPAT_meta-somlabs = "dunfell"
```

## conf/machine/visionsom-g2l-cb.conf
```bitbake
#@TYPE: Machine
#@NAME: visionsom-g2l-cb
#@DESCRIPTION: RZ/G2L SMARC platform

SOC_FAMILY = "r9a07g044l"
require conf/machine/include/rzg2l-common.inc
require conf/machine/include/cip-core.inc

DEFAULTTUNE ?= "cortexa55"

TUNE_CONF ?= "conf/machine/include/tune-cortexa55.inc"
require ${TUNE_CONF}

PREFERRED_PROVIDER_virtual/kernel="linux-renesas"

UBOOT_CONFIG ??= "visionsom-g2l"
UBOOT_CONFIG[visionsom-g2l] = "visionsom-g2l_defconfig"

PMIC_SUPPORT ?= "0"

KERNEL_DEVICETREE = " \
	renesas/visionsom-g2l-cb.dtb \
"

IMAGE_FSTYPES_append += "wic.bz2"
WKS_FILE = "visionsom.wks"

MACHINE_FEATURES += "wifi bluetooth"
MACHINE_EXTRA_RRECOMMENDS += " \
  kernel-devicetree \
  kernel-module-brcmfmac \
  kernel-module-hciuart \
  linux-firmware-murata-1dx \
"
```

## conf/machine/visionsom-v2l-cb.conf
```bitbake
#@TYPE: Machine
#@NAME: visionsom-v2l-cb
#@DESCRIPTION: RZ/V2L SMARC platform

SOC_FAMILY = "r9a07g054l"
require conf/machine/include/rzv2l-common.inc
require conf/machine/include/cip-core.inc

DEFAULTTUNE ?= "cortexa55"

TUNE_CONF ?= "conf/machine/include/tune-cortexa55.inc"
require ${TUNE_CONF}

PREFERRED_PROVIDER_virtual/kernel="linux-renesas"

UBOOT_CONFIG ??= "visionsom-v2l"
UBOOT_CONFIG[visionsom-v2l] = "visionsom-v2l_defconfig"

PMIC_SUPPORT ?= "0"

KERNEL_DEVICETREE = " \
	renesas/visionsom-v2l-cb.dtb \
"

IMAGE_FSTYPES_append += "wic.bz2"
WKS_FILE = "visionsom.wks"

MACHINE_FEATURES += "wifi bluetooth"
MACHINE_EXTRA_RRECOMMENDS += " \
  kernel-devicetree \
  kernel-module-brcmfmac \
  kernel-module-hciuart \
  linux-firmware-murata-1dx \
"
```
